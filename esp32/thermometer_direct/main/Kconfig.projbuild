## esp32/thermometer_direct/main/Kconfig.projbuild
```kconfig
menu "Thermometer Configuration"
    config EXAMPLE_CLIENT_SESSION_TICKETS
        bool "Enable Client session ticket support"
        default y
        select ESP_TLS_CLIENT_SESSION_TICKETS
        help
            Enable the client session ticket support for the example.

    config TEMPERATURE_DB_SERVER_URL
        string "Temperature DB Server URL for saving temperature data"
        default "localhost:8080"
        help
            The url of the server to which this example connect and send temperature.
endmenu
```
